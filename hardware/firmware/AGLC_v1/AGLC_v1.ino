/*
  Images generated using https://javl.github.io/image2cpp/
*/

#include <SPI.h>
#include <Wire.h>
#include <Adafruit_GFX.h>
#include <Adafruit_SSD1306.h>

#define SCREEN_WIDTH 128
#define SCREEN_HEIGHT 64

#define LOGO_WIDTH 128
#define LOGO_HEIGHT 64

//#define SDA 23
//#define SCL 22
#define MULTIPLEX_1_ADDR 0x70

#define SOFTWARE_ID "AGLC"
#define SOFTWARE_VERSION "v1"
#define DELIMITER "________"
#define READY_TO_CONNECT "ready_to_connect"
#define CONNECTED "connected"

const byte DATA_MAX_SIZE = 32;
char incomingMessage[DATA_MAX_SIZE];

static const unsigned char PROGMEM logo_bmp[] =
    {0xff, 0xff, 0xff, 0xff, 0xff, 0xff, 0xff, 0xff, 0xff, 0xff, 0xff, 0xff, 0xff, 0xff, 0xff, 0xff,
     0xff, 0xff, 0xff, 0xff, 0xff, 0xff, 0xff, 0xff, 0xff, 0xff, 0xff, 0xff, 0xff, 0xff, 0xff, 0xff,
     0xff, 0xff, 0xff, 0xff, 0xff, 0xff, 0xff, 0xff, 0xff, 0xff, 0xff, 0xff, 0xff, 0xff, 0xff, 0xff,
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     0xff, 0xff, 0xff, 0xff, 0xff, 0xff, 0xff, 0xff, 0xff, 0xff, 0xff, 0xff, 0xff, 0xff, 0xff, 0xff};

Adafruit_SSD1306 display0(SCREEN_WIDTH, SCREEN_HEIGHT, &Wire, -1);
Adafruit_SSD1306 display1(SCREEN_WIDTH, SCREEN_HEIGHT, &Wire, -1);

void setup()
{
  Serial.begin(115200);
  switchToDevice(0);

  if (!display0.begin(SSD1306_SWITCHCAPVCC, 0x3C))
  {
    Serial.println(F("SSD1306 allocation failed"));
    for (;;)
      ;
  }
  switchToDevice(1);
  if (!display1.begin(SSD1306_SWITCHCAPVCC, 0x3C))
  {
    Serial.println(F("SSD1306 allocation failed"));
    for (;;)
      ;
  }
  analogReadResolution(12);
  analogSetAttenuation(ADC_11db);

  displayLogo();
  connect();
}

void loop()
{
  
  switchToDevice(1);
  display1.clearDisplay();
  display1.setCursor(0, 0);
  display1.setTextSize(1);
  display1.println(F("Connected"));
  display1.println("This will be the");
  display1.println("info screen here.");
  display1.display();
  delay(5000);
}

void displayLogo(void)
{
  switchToDevice(0);
  display1.clearDisplay();

  display1.drawBitmap(
      (display1.width() - LOGO_WIDTH) / 2,
      (display1.height() - LOGO_HEIGHT) / 2,
      logo_bmp, LOGO_WIDTH, LOGO_HEIGHT, 1);
  display1.display();
  delay(2000);
  display1.clearDisplay();
}
void connect()
{
  while (true) {
    switchToDevice(1);
    if (checkIfConnected()) {
      return;
    }

    display1.clearDisplay();
    display1.setTextSize(2);
    display1.setTextColor(WHITE);
    display1.setCursor(0, 0);

    display1.println(F("Connecting"));
    display1.println("");
    display1.setTextColor(BLACK, WHITE);
    display1.display();
    for (int i = 0; i < 10; i++) {
      display1.print(F(" "));
      display1.display();
      delay(100);
    }

    Serial.println(SOFTWARE_ID DELIMITER SOFTWARE_VERSION DELIMITER READY_TO_CONNECT);

    for (int i = 0; i < 10; i++) {
      display1.clearDisplay();
      display1.setCursor(0, 0);
      display1.setTextColor(WHITE, BLACK);
      display1.println(F("Connecting"));
      display1.println("");
      for (int j = 0; j < i; j++) {
        display1.print(F(" "));
      }
      display1.setTextColor(BLACK, WHITE);
      for (int j = 0; j < 10 - i; j++) {
        display1.print(F(" "));
      }
      display1.display();
      delay(100);
    }
  }

  display1.display();
  delay(2000);
}

void receiveData() {
  Serial.println("Checking for data");
  static char endMarker = '\n';
  char receivedChar;
  int ndx = 0;
  memset(incomingMessage, 32, sizeof(incomingMessage));
  while (Serial.available() > 0) {
    receivedChar = Serial.read();
    if (receivedChar == endMarker) {
      incomingMessage[ndx] = '\0';
      return;
    }
    incomingMessage[ndx] = receivedChar;
    ndx++;
    if (ndx >= DATA_MAX_SIZE) {
      Serial.print("error" DELIMITER "incomplete message" DELIMITER);
      Serial.println(incomingMessage);
      memset(incomingMessage, 32, sizeof(incomingMessage));
    }
  }
}

bool checkIfConnected() {
  receiveData();
  String m = incomingMessage;
  return m == CONNECTED;
}

void switchToDevice(uint8_t bus) {
  Wire.beginTransmission(/*SDA, SCL, */MULTIPLEX_1_ADDR);
  Wire.write(1 << bus);
  Wire.endTransmission();
}